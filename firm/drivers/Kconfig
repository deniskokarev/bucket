## firm/drivers/Kconfig
```kconfig
menu "Bucket out-of-tree drivers"

rsource "morse_button/Kconfig"
rsource "signal_led/Kconfig"

endmenu
```

## firm/drivers/dts/bindings/input/dkv,morse-button.yaml
```yaml
description: |
  Morse-code button.

  Decodes the press/release timing of one input key (e.g. a gpio-keys button)
  into a sequence of dots (short press) and dashes (long press). Each child
  node declares one code; when a released sequence matches a code, the
  handler the application registered for that entry is called.

  A code fires on the release that completes it, unless it is also the
  prefix of a longer code; then it fires once the button has been idle for
  reset-delay-ms. Idle time also ends (resets) any sequence in progress.

  Example: tap to show status, short-short-long to re-pair.

    sw1_morse: sw1-morse {
        compatible = "dkv,morse-button";
        input-code = <INPUT_KEY_0>;
        long-press-ms = <2000>;
        reset-delay-ms = <1500>;

        morse_status: status {
            code = ".";
            label = "show status";
        };
        morse_rebond: rebond {
            code = "..-";
            label = "clear bonds and pair";
        };
    };

  Application code binds a handler per entry at boot:

    morse_button_set_handler(MORSE_BUTTON_DEV(DT_NODELABEL(morse_rebond)),
                             MORSE_BUTTON_ENTRY(DT_NODELABEL(morse_rebond)),
                             on_rebond, NULL);

compatible: "dkv,morse-button"

include: base.yaml

properties:
  input:
    type: phandle
    description: |
      Input device whose events are decoded. If omitted, events from any
      device are decoded, which also lets `input report` from the shell
      inject presses for testing.

  input-code:
    type: int
    required: true
    description: Key code to decode, e.g. INPUT_KEY_0.

  long-press-ms:
    type: int
    default: 2000
    description: A press at least this long is a dash; shorter is a dot.

  reset-delay-ms:
    type: int
    default: 1500
    description: |
      Idle time after a release that ends the current sequence.

child-binding:
  description: One code and the action it stands for.
  properties:
    code:
      type: string
      required: true
      description: Sequence of "." (short) and "-" (long) presses.
    label:
      type: string
      description: Human-readable action name, used in logs.
```

## firm/drivers/dts/bindings/led/dkv,signal-led.yaml
```yaml
description: |
  Signal LED: one LED showing coded feedback patterns (off, solid, blink,
  sine glow), each optionally for a limited time.

  Give either `pwms` (hardware PWM) or `gpios` (plain GPIO, driven with
  software PWM for intermediate brightness).

    status_led: status-led {
        compatible = "dkv,signal-led";
        gpios = <&gpiob 5 GPIO_ACTIVE_HIGH>;
    };

compatible: "dkv,signal-led"

include: base.yaml

properties:
  pwms:
    type: phandle-array
    description: PWM channel driving the LED.

  gpios:
    type: phandle-array
    description: GPIO driving the LED (software PWM).

  soft-pwm-hz:
    type: int
    default: 100
    description: |
      Software PWM frequency when driven through `gpios`. Keep it above the
      visible flicker threshold (~80 Hz).
```

## firm/drivers/morse_button/Kconfig
```kconfig
config MORSE_BUTTON
	bool "Morse-code button decoder"
	default y
	depends on DT_HAS_DKV_MORSE_BUTTON_ENABLED
	select INPUT
	select DKV_WORKQUEUE
	help
	  Decode press/release timing of one input key into dot/dash
	  sequences and dispatch the codes listed in the devicetree.

if MORSE_BUTTON

config MORSE_BUTTON_MAX_SYMBOLS
	int "Longest code sequence"
	default 8
	help
	  Sequences longer than this are discarded as unmatched.

module = MORSE_BUTTON
module-str = morse_button
source "subsys/logging/Kconfig.template.log_config"

endif
```

## firm/drivers/signal_led/Kconfig
```kconfig
config SIGNAL_LED
	bool "Signal LED (solid / blink / sine glow)"
	default y
	depends on DT_HAS_DKV_SIGNAL_LED_ENABLED
	select GPIO
	select PWM
	help
	  Coded feedback LED patterns on a PWM LED, or on a plain GPIO LED
	  using software PWM.

if SIGNAL_LED

module = SIGNAL_LED
module-str = signal_led
source "subsys/logging/Kconfig.template.log_config"

endif
```
